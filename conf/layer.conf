## conf/machine/axon-am62ax.conf
```bitbake
#@TYPE: Machine
#@NAME: AXON-AM62AX
#@DESCRIPTION: Machine configuration for the TechNexion AXON-AM62AX

require conf/machine/include/am62axx.inc

OVERRIDES_append = ":tn"
OVERRIDES_append = "${@'' if (d.getVar('RF_FIRMWARES', True) is None or len(d.getVar('RF_FIRMWARES', True)) == 0) else ':%s' % ':'.join([fw.lower() for fw in d.getVar('RF_FIRMWARES', True).split(' ') if fw])}"

PREFERRED_PROVIDER_virtual/kernel_tn = "linux-tn-ti"
PREFERRED_PROVIDER_virtual/bootloader_tn = "u-boot-tn-ti"
PREFERRED_PROVIDER_u-boot_tn = "u-boot-tn-ti"
LICENSE_FLAGS_WHITELIST_append = " commercial_qca commercial_tn"

MACHINE_FEATURES += "gpu nxp89xx"

KERNEL_DEVICETREE_PREFIX = " \
    ti/k3-am62a7-axon \
"

KERNEL_DEVICETREE = " \
    ti/k3-am62a7-axon-wb.dtb \
"

UBOOT_MACHINE = "axon-am62ax_a53_defconfig"

SERIAL_CONSOLES = "115200;ttyS2"
SERIAL_BLUETOOTH = "3000000;ttyS1"
```

## conf/machine/axon-am62xx.conf
```bitbake
#@TYPE: Machine
#@NAME: AXON-AM62XX
#@DESCRIPTION: Machine configuration for the TechNexion AXON-AM62XX

require conf/machine/include/am62xx.inc
require conf/machine/include/tn-base.inc

MACHINE_FEATURES += "gpu nxpiw416-sdio"

KERNEL_DEVICETREE_PREFIX = " \
    ti/k3-am625-axon \
"

KERNEL_DEVICETREE = " \
    ti/k3-am625-axon-wb.dtb \
    ti/k3-am625-axon-wb-lcd-vl050-070-8048.dtbo \
    ti/k3-am625-axon-wb-lcd-vl0808060.dtbo \
    ti/k3-am625-axon-wb-lvds-vl10112880.dtbo \
    ti/k3-am625-axon-wb-lvds-vl156192108.dtbo \
"

UBOOT_MACHINE = "axon-am62xx_a53_defconfig"

SERIAL_CONSOLES = "115200;ttyS2"
SERIAL_BLUETOOTH = "3000000;ttyS1"
```
