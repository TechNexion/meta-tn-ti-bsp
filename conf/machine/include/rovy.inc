## conf/machine/include/rovy.inc
```bitbake
require conf/machine/include/tnk3.inc
SOC_FAMILY:append = ":j721e"

MACHINE_FEATURES += "screen gpu"

require conf/machine/include/mesa-pvr.inc
PREFERRED_PROVIDER_virtual/gpudriver ?= "ti-img-rogue-driver"

IMAGE_BOOT_FILES += "sysfw.itb"

# Default on J721e is for GP
IMAGE_BOOT_FILES += "tiboot3-j721e-gp-rovy.bin"
IMAGE_BOOT_FILES += "sysfw-j721e-gp-rovy.itb"

# Since default on J721e is for GP, add a version for HS-FS
#IMAGE_BOOT_FILES += "tiboot3-j721e_sr2-hs-fs-rovy.bin"
#IMAGE_BOOT_FILES += "sysfw-j721e_sr2-hs-fs-rovy.itb"

# Since default on J721e is for GP, add a version for HS-SE
#IMAGE_BOOT_FILES += "tiboot3-j721e_sr1_1-hs-rovy.bin"
#IMAGE_BOOT_FILES += "sysfw-j721e_sr1_1-hs-rovy.itb"

TFA_BOARD = "generic"

OPTEEMACHINE = "k3-j721e"

MACHINE_ESSENTIAL_EXTRA_RRECOMMENDS += "cadence-mhdp-fw vxd-dec-fw ti-eth-fw"
```

## conf/machine/include/tnk3.inc
```bitbake
require conf/machine/include/k3.inc

# Common override for all TechNexion machines
MACHINEOVERRIDES =. "tn:"

# Install modules in initramfs and roofs
PACKAGE_INSTALL_append = " kernel-modules"

INITRAMFS_FSTYPES = "wic.xz"

UBOOT_SIGN_ENABLE = "0"

PREFERRED_PROVIDER_virtual/kernel:tn = "linux-tn-ti"
PREFERRED_PROVIDER_virtual/bootloader:tn = "u-boot-tn-ti"
PREFERRED_PROVIDER_u-boot:tn = "u-boot-tn-ti"

KERNEL_IMAGETYPE = "Image"
KERNEL_IMAGETYPES = "Image vmlinux.gz"
```

## conf/machine/rovy-4vm-k3r5.conf
```bitbake
#@TYPE: Machine
#@NAME: J7 EVM (R5F)
#@DESCRIPTION: Machine configuration for the TI J7 EVM (R5F core)

require conf/machine/include/tnk3r5.inc

SYSFW_SOC = "j721e"
SYSFW_CONFIG = "evm"
SYSFW_SUFFIX = "gp"

UBOOT_MACHINE = "j721e_rovy_r5_defconfig"
```

## conf/machine/rovy-4vm.conf
```bitbake
#@TYPE: Machine
#@NAME: ROVY-4VM
#@DESCRIPTION: Machine configuration for the TechNexion ROVY-4VM based on TI TDA4VM (J721E)

require conf/machine/include/rovy.inc

# Any recipe compatible with j721-evm is also compatible with ROVY-4VM
MACHINEOVERRIDES =. "j721e-evm:"

PLAT_SOC:rovy-4vm = "j721e"

MACHINE_FEATURES += " screen can emmc pci gpu"

SERIAL_CONSOLES = "115200;ttyS2 115200;ttyS3"
SERIAL_CONSOLES_CHECK = "${SERIAL_CONSOLES}"

# Since J721e does not support multi-cert tiboot3.bin add standalone sysfw.itb
IMAGE_BOOT_FILES += "sysfw.itb"

KERNEL_DEVICETREE = " \
    ti/k3-j721e-edgeai-apps.dtbo \
    ti/k3-j721e-rovy-evm.dtb \
    ti/k3-j721e-rovy-evm-mcu-uarts.dtbo \
    ti/k3-j721e-rovy-evm-vizionpanel-vl10112880.dtbo \
    ti/k3-j721e-rovy-evm-4xsgmii.dtbo \
    ti/k3-j721e-rovy-evm-fusion.dtbo \
    ti/k3-fpdlink-tevi-ap1302-0-0.dtbo \
    ti/k3-fpdlink-tevi-ap1302-0-1.dtbo \
    ti/k3-fpdlink-tevi-ap1302-0-2.dtbo \
    ti/k3-fpdlink-tevi-ap1302-0-3.dtbo \
    ti/k3-fpdlink-tevi-ap1302-1-0.dtbo \
    ti/k3-fpdlink-tevi-ap1302-1-1.dtbo \
    ti/k3-fpdlink-tevi-ap1302-1-2.dtbo \
    ti/k3-fpdlink-tevi-ap1302-1-3.dtbo \
"

PREFERRED_PROVIDER_virtual/kernel_${MACHINE} = "linux-tn-ti"
PREFERRED_PROVIDER_virtual/bootloader_${MACHINE} = "u-boot-tn-ti"

UBOOT_MACHINE = "j721e_rovy_a72_config"

OPTEEMACHINE = "k3-j721e"
OPTEEOUTPUTMACHINE = "k3"

BBMULTICONFIG = "k3r5"
```
